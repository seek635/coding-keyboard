## boards/shields/claudepad/Kconfig.defconfig
```kconfig
if SHIELD_CLAUDEPAD

# 蓝牙设备名（连接时显示的名字）
# 注意：必须少于 16 个字符，否则截断
config ZMK_KEYBOARD_NAME
    default "ClaudePad"

endif
```

## boards/shields/claudepad/Kconfig.shield
```kconfig
# ClaudePad shield 标识
# 注意：逗号后和键盘名中不能有空格
config SHIELD_CLAUDEPAD
    def_bool $(shields_list_contains,claudepad)
```

## firmware/config/west.yml
```yaml
# ZMK 上游依赖
# -----------------------------------------------------------------------------
# 版本锁定在稳定的 tag 上，避免上游改动导致构建失败。
# 想升级时改 revision 即可。
manifest:
  remotes:
    - name: zmkfirmware
      url-base: https://github.com/zmkfirmware
  projects:
    - name: zmk
      remote: zmkfirmware
      revision: v0.1.0
      import: app/west.yml
  self:
    path: config
```
